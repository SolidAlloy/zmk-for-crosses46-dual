&trackball_peripheral {
    cpi = <200>;
    y-invert;
	/delete-property/ x-invert;
};

&trackball_peripheral_split {
  device = <&trackball_peripheral>;
  input-processors = <&zip_ble_report_rate_limit>;
};