#include <scroll-snap.dtsi>

&trackball_central {
    cpi = <600>;
};

&trackball_central_listener {
    status = "okay";
    device = <&trackball_central>;
    input-processors 
        = <&zip_xy_scaler 2 1>
        , <&zip_ble_report_rate_limit>;
		
	sniper_override {
        layers = <4>;
        input-processors = <&zip_ble_report_rate_limit>;
    };
};

&trackball_peripheral_listener {
  status = "okay";
  input-processors
    = <&zip_scroll_snap>
    , <&zip_xy_to_scroll_mapper>;
};